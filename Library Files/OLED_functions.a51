OLED_ADDR EQU 78H
OLED_NCMD EQU 00H
OLED_NDATA EQU 40H
OLED_OFF EQU 0AEH
OLED_ON EQU 0AFH
OLED_MEMMODE EQU 20H //HORIZONTAL INCREMENT
OLED_COLADDR EQU 21H
OLED_LINEADDR EQU 22H	//PAGE_ADDR
OLED_NOR EQU 0A6H
OLED_INV EQU 0A7H
DIV_RATIO EQU 0D5H
MUX_RATIO EQU 0A8H
DIS_OFFSET EQU 0D3H
START_LINE EQU 40H
CHARGE_PUMP EQU 8DH
SEGMENT_REMAP EQU 0A1H	//HORIZONTAL LEFT/RIGHT
DIR_DEC EQU 0C8H
COM_PINS EQU 0DAH
CONTRAST_CONTROL EQU 81H
PRECHARGE_PERIOD EQU 0D9H
VCOM_DESELECT EQU 0DBH
ON_RESUME EQU 0A4H
	
EXTRN CODE (I2C_INIT)
EXTRN CODE (I2C_RSTART)
EXTRN CODE (I2C_START)
EXTRN CODE (I2C_STOP)
EXTRN CODE (I2C_SENDBYTE)
EXTRN CODE (I2C_SENDACK)
EXTRN CODE (I2C_SENDNACK)
EXTRN CODE (I2C_RECBYTE)
	
PUBLIC OLED_INIT
PUBLIC OLED_CMD
PUBLIC OLED_DATA
PUBLIC OLED_SETCUR
PUBLIC OLED_CLEAR
	
SEG_OLED SEGMENT CODE
	RSEG SEG_OLED
	
OLED_INIT:
	ACALL I2C_INIT
	MOV R6,#OLED_OFF
	ACALL OLED_CMD
	MOV R6,#DIV_RATIO
	ACALL OLED_CMD
	MOV R6,#80H
	ACALL OLED_CMD
	MOV R6,#MUX_RATIO
	ACALL OLED_CMD
	MOV R6,#3FH
	ACALL OLED_CMD
	MOV R6,#DIS_OFFSET
	ACALL OLED_CMD
	MOV R6,#00H
	ACALL OLED_CMD
	MOV R6,#START_LINE
	ACALL OLED_CMD
	MOV R6,#CHARGE_PUMP
	ACALL OLED_CMD
	MOV R6,#14H
	ACALL OLED_CMD
	MOV R6,#OLED_MEMMODE
	ACALL OLED_CMD
	MOV R6,#0
	ACALL OLED_CMD
	MOV R6,#SEGMENT_REMAP
	ACALL OLED_CMD
	MOV R6,#DIR_DEC
	ACALL OLED_CMD
	MOV R6,#COM_PINS
	ACALL OLED_CMD
	MOV R6,#12H
	ACALL OLED_CMD
	MOV R6,#CONTRAST_CONTROL
	ACALL OLED_CMD
	MOV R6,#0CFH
	ACALL OLED_CMD
	MOV R6,#PRECHARGE_PERIOD
	ACALL OLED_CMD
	MOV R6,#0F1H
	ACALL OLED_CMD
	MOV R6,#VCOM_DESELECT
	ACALL OLED_CMD
	MOV R6,#40H
	ACALL OLED_CMD
	MOV R6,#ON_RESUME
	ACALL OLED_CMD
	MOV R6,#OLED_NOR
	ACALL OLED_CMD
	MOV R6,#OLED_ON
	ACALL OLED_CMD
	ACALL OLED_CLEAR
RET

OLED_CMD:
	ACALL I2C_START
	MOV A,#OLED_ADDR
	ACALL I2C_SENDBYTE
	MOV A,#OLED_NCMD
	ACALL I2C_SENDBYTE
	MOV A,R6
	ACALL I2C_SENDBYTE
	ACALL I2C_STOP
RET

OLED_DATA:
	ACALL I2C_START
	MOV A,#OLED_ADDR
	ACALL I2C_SENDBYTE
	MOV A,#OLED_NDATA
	ACALL I2C_SENDBYTE
	MOV A,R6
	ACALL I2C_SENDBYTE
	ACALL I2C_STOP
RET

OLED_SETCUR:
	MOV R6,#OLED_COLADDR
	ACALL OLED_CMD
	MOV A,R4
	MOV R6,A
	ACALL OLED_CMD
	MOV R6,#127
	ACALL OLED_CMD
	MOV R6,#OLED_LINEADDR
	ACALL OLED_CMD
	MOV A,R5
	MOV R6,A
	ACALL OLED_CMD
	MOV R6,#7
	ACALL OLED_CMD
RET

OLED_CLEAR:
	MOV R4,#0
	MOV R5,#0
NEXT:	ACALL OLED_SETCUR
	MOV R0,#128
	ACALL I2C_START
	MOV A,#OLED_ADDR
	ACALL I2C_SENDBYTE
	MOV A,#OLED_NDATA
	ACALL I2C_SENDBYTE
AGAIN1:
	MOV A,#0
	ACALL I2C_SENDBYTE
	DJNZ R0,AGAIN1
	INC R5
	CJNE R5,#8,NEXT
	ACALL I2C_STOP
	RET
END