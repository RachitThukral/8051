SDA EQU P2.1
SCL EQU P2.0
	
PUBLIC I2C_INIT
PUBLIC I2C_RSTART
PUBLIC I2C_START
PUBLIC I2C_STOP
PUBLIC I2C_SENDBYTE
PUBLIC I2C_SENDACK
PUBLIC I2C_SENDNACK
PUBLIC I2C_RECBYTE
	
SEG_I2C SEGMENT CODE
	RSEG SEG_I2C
	
I2C_INIT:	;initialize i2c lines
	SETB SDA
	SETB SCL
RET

I2C_START:	;start i2c
	SETB SCL
	CLR SDA
	CLR SCL
RET

I2C_RSTART:	;restart i2c without stop
	CLR SCL
	SETB SDA
	SETB SCL
	CLR SDA
RET

I2C_STOP:	;stop i2c
	CLR SCL
	CLR SDA
	SETB SCL
	SETB SDA
RET
 
I2C_SENDBYTE:	;send one byte through i2c
	MOV R7,#08
BACK:
	CLR SCL
	RLC A
	MOV SDA,C
	SETB SCL
	DJNZ R7,BACK
	CLR SCL
	SETB SDA
	SETB SCL
	JB SDA,$
	CLR SCL
RET
 
I2C_SENDACK:	;acknowledge after receive
	CLR SDA
	SETB SCL
	CLR SCL
	SETB SDA
RET
 
I2C_SENDNACK:	;not acknowledge after receive
	SETB SDA
	SETB SCL
	CLR SCL
	SETB SCL
RET
 
I2C_RECBYTE:	;receive one byte through i2c
	MOV R7,#08
BACK2:
	CLR SCL
	SETB SCL
	MOV C,SDA
	RLC A
	DJNZ R7,BACK2
	CLR SCL
	SETB SDA
RET
END