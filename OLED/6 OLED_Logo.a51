;Program: WAP to display a logo on OLED using lookup table
OLED_ADDR EQU 78H
OLED_NCMD EQU 00H
OLED_NDATA EQU 40H
	
EXTRN CODE (OLED_INIT)	;import OLED functions
EXTRN CODE (OLED_CMD)
EXTRN CODE (OLED_DATA)
EXTRN CODE (OLED_SETCUR)
EXTRN CODE (OLED_CLEAR)
EXTRN CODE (I2C_INIT)	;import i2c functions
EXTRN CODE (I2C_RSTART)
EXTRN CODE (I2C_START)
EXTRN CODE (I2C_STOP)
EXTRN CODE (I2C_SENDBYTE)
EXTRN CODE (I2C_SENDACK)
EXTRN CODE (I2C_SENDNACK)
EXTRN CODE (I2C_RECBYTE)

SEG_MAIN SEGMENT CODE
	ORG 0
	LJMP MAIN
	
	RSEG SEG_MAIN
MAIN:
	ACALL OLED_INIT	;initialize OLED
	MOV R4,#0
	MOV R5,#0
	ACALL OLED_SETCUR	;set cursor to (0,0)
	MOV R0,#128
	ACALL I2C_START
	MOV A,#OLED_ADDR	;OLED address
	ACALL I2C_SENDBYTE
	MOV A,#OLED_NDATA	;send data
	ACALL I2C_SENDBYTE
	MOV DPTR,#LOGO0	;display logo
	MOV R1,#5
AGAIN_:	MOV R0,#128
AGAIN:	CLR A
	MOVC A,@A+DPTR
	INC DPTR
	ACALL I2C_SENDBYTE
	DJNZ R0,AGAIN
	DJNZ R1,AGAIN_
	ACALL I2C_STOP
	SJMP $

ORG 300H	;Logo data
LOGO0: DB 0,0,0,0,0,0,0,0, 0xFF,0,0,0,0,0,0,0, 0xFF,0,0,0,0,0,0,0, 0xFF,0,0,0,0,0,0,0, 0xFF,0,0,0,0,0,0,0
ORG 380H
LOGO1: DB 1,1,1,1,1,1,1,1, 0xFF,1,1,1,1,1,1,1, 1,1,1,1,1,1,1,1, 1,1,1,1,1,1,1,1, 0xFF,1,1,1,1,1,1,1
ORG 400H
LOGO2: DB 1,1,1,1,1,1,1,1, 0xFF,0,0,0,0,0,0,0, 0,0,0,0,0,0,0,0, 0,0,0,0,0,0,0,0, 0xFF,1,1,1,1,1,1,1
ORG 480H
LOGO3: DB 1,1,1,1,1,1,1,1, 0xFF,0,0,0,0,0,0,0, 0,0,0,0,0,0,0,0, 0,0,0,0,0,0,0,0, 0xFF,1,1,1,1,1,1,1
ORG 500H
LOGO4: DB 1,1,1,1,1,1,1,1, 0xFF,1,1,1,1,1,1,1, 0xFF,1,1,1,1,1,1,1, 0xFF,1,1,1,1,1,1,1, 0xFF,1,1,1,1,1,1,1
ORG 580H
DB 0
END