;Program: WAP to draw rectangle on OLED boundary
OLED_ADDR EQU 78H
OLED_NCMD EQU 00H
OLED_NDATA EQU 40H
	
EXTRN CODE (OLED_INIT)	;import OLED functions
EXTRN CODE (OLED_CMD)
EXTRN CODE (OLED_DATA)
EXTRN CODE (OLED_SETCUR)
EXTRN CODE (OLED_CLEAR)
EXTRN CODE (I2C_INIT)	;import i2c functions
EXTRN CODE (I2C_RSTART)
EXTRN CODE (I2C_START)
EXTRN CODE (I2C_STOP)
EXTRN CODE (I2C_SENDBYTE)
EXTRN CODE (I2C_SENDACK)
EXTRN CODE (I2C_SENDNACK)
EXTRN CODE (I2C_RECBYTE)

SEG_MAIN SEGMENT CODE
	ORG 0
	LJMP MAIN
	
	RSEG SEG_MAIN
MAIN:
	ACALL OLED_INIT	;initialize OLED
	MOV R4,#0
	MOV R5,#0
	ACALL OLED_SETCUR	;set cursor to (0,0)
	ACALL I2C_START
	MOV A,#OLED_ADDR
	ACALL I2C_SENDBYTE
	MOV A,#OLED_NDATA
	ACALL I2C_SENDBYTE
	MOV A,#0FFH			;LINE 0
	ACALL I2C_SENDBYTE
	MOV R0,#126
AGAIN:
	MOV A,#01H
	ACALL I2C_SENDBYTE
	DJNZ R0,AGAIN
	MOV A,#0FFH
	ACALL I2C_SENDBYTE
	MOV R1,#6			;LINE 1-6
AGAIN_LINE:
	MOV A,#0FFH
	ACALL I2C_SENDBYTE
	MOV R0,#126
AGAIN1:
	MOV A,#00H
	ACALL I2C_SENDBYTE
	DJNZ R0,AGAIN1
	MOV A,#0FFH
	ACALL I2C_SENDBYTE
	DJNZ R1,AGAIN_LINE
	MOV A,#0FFH			;LINE 7
	ACALL I2C_SENDBYTE
	MOV R0,#126
AGAIN2:
	MOV A,#80H
	ACALL I2C_SENDBYTE
	DJNZ R0,AGAIN2
	MOV A,#0FFH
	ACALL I2C_SENDBYTE
	ACALL I2C_STOP
	SJMP $
END