;Program: WAP to draw vertical line on left side of OLED
OLED_ADDR EQU 78H
OLED_NCMD EQU 00H
OLED_NDATA EQU 40H
	
EXTRN CODE (OLED_INIT)	;import OLED functions
EXTRN CODE (OLED_CMD)
EXTRN CODE (OLED_DATA)
EXTRN CODE (OLED_SETCUR)
EXTRN CODE (OLED_CLEAR)
EXTRN CODE (I2C_INIT)	;import i2c functions
EXTRN CODE (I2C_RSTART)
EXTRN CODE (I2C_START)
EXTRN CODE (I2C_STOP)
EXTRN CODE (I2C_SENDBYTE)
EXTRN CODE (I2C_SENDACK)
EXTRN CODE (I2C_SENDNACK)
EXTRN CODE (I2C_RECBYTE)

SEG_MAIN SEGMENT CODE
	ORG 0
	LJMP MAIN
	
	RSEG SEG_MAIN
MAIN:
	ACALL OLED_INIT	;initialize OLED
	MOV R4,#0
	MOV R5,#0
	ACALL OLED_SETCUR	;set cursor to (0,0)
	ACALL I2C_START
	MOV A,#OLED_ADDR	;OLED address
	ACALL I2C_SENDBYTE
	MOV A,#OLED_NDATA	;send data
	ACALL I2C_SENDBYTE
	MOV R1,#8
AGAIN_LINE:	MOV A,#0FFH	;draw line on left pixels
	ACALL I2C_SENDBYTE
	MOV R0,#127
AGAIN:	MOV A,#00H
	ACALL I2C_SENDBYTE
	DJNZ R0,AGAIN
	DJNZ R1,AGAIN_LINE
	ACALL I2C_STOP
	SJMP $
END