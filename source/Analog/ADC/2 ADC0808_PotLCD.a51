;Program: Read potentiometer output using ADC0808 channel 1 and display it on LCD
E EQU P2.7
RS EQU P2.6
LCD EQU P0
ADC_DATA EQU P1
ADC_SC EQU P3.3
ADC_EOC EQU P3.4
ADC_C EQU P3.7
ADC_B EQU P3.6
ADC_A EQU P3.5
ADC_ALE EQU P2.0
ORG 00H
	ACALL LCD_INIT
	MOV ADC_DATA,#0FFH	;make port = input
	CLR ADC_ALE
	CLR ADC_SC
BACK:
	SETB ADC_C	;select channel 1 of ADC
	CLR ADC_B
	CLR ADC_A
	SETB ADC_ALE
	SETB ADC_SC
	CLR ADC_ALE
	CLR ADC_SC
HERE:	JB ADC_EOC,HERE	;wait for end of conversion
HERE1:	JNB ADC_EOC,HERE1
	MOV A,ADC_DATA	;read the data
	MOV R4, #80H	;convert to ASCII
	ACALL LCD_COMMAND	;and display on LCD
	MOV B,#10
	DIV AB
	MOV R3,B
	MOV B,#10
	DIV AB
	ADD A,#30H
	MOV R4, A
	ACALL LCD_DATA
	MOV A,B
	ADD A,#30H
	MOV R4, A
	ACALL LCD_DATA
	MOV A,R3
	ADD A,#30H
	MOV R4, A
	ACALL LCD_DATA
	ACALL DELAY
	ACALL DELAY
	ACALL DELAY
	ACALL DELAY
	ACALL DELAY
	SJMP BACK

LCD_INIT:
	CLR E
	CLR RS
	MOV R4, #38H	;Use 2 lines and 5в7 matrix for LCD
	ACALL LCD_COMMAND
	ACALL DELAY
	MOV R4, #0CH	;LCD ON, Cursor OFF
	ACALL LCD_COMMAND
	ACALL DELAY
	MOV R4, #01H	;LCD clear
	ACALL LCD_COMMAND
	ACALL DELAY
RET

LCD_COMMAND:	;Function for LCD command
	CLR RS
	MOV LCD, R4
	SETB E
	ACALL DELAY
	CLR E
RET
	
LCD_DATA:	;Function for LCD data
	SETB RS
	MOV LCD, R4
	SETB E
	ACALL DELAY
	CLR E
RET
	
DELAY:	;Function for delay
		MOV R7, #200
LOOP1:	MOV R6, #200
LOOP:	DJNZ R6, LOOP
		DJNZ R7, LOOP1
RET
END