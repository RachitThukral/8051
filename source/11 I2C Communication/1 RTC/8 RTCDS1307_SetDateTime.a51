;Program: WAP to set the time and date on RTC DS1307
EXTRN CODE (I2C_INIT)	;import i2c functions
EXTRN CODE (I2C_RSTART)
EXTRN CODE (I2C_START)
EXTRN CODE (I2C_STOP)
EXTRN CODE (I2C_SENDBYTE)
EXTRN CODE (I2C_SENDACK)
EXTRN CODE (I2C_SENDNACK)
EXTRN CODE (I2C_RECBYTE)

SEG_MAIN SEGMENT CODE
	ORG 0
	LJMP MAIN
	
	RSEG SEG_MAIN
MAIN:	
	ACALL I2C_INIT
	ACALL I2C_START
	MOV A,#0D0H	;DS1307 address write
	ACALL I2C_SENDBYTE
	MOV A,#00H	;start location
	ACALL I2C_SENDBYTE
	MOV A,#00H	;seconds
	ACALL I2C_SENDBYTE
	MOV A,#25H	;minutes
	ACALL I2C_SENDBYTE
	MOV A,#08H	;hours
	ACALL I2C_SENDBYTE
	MOV A,#01H	;day
	ACALL I2C_SENDBYTE
	MOV A,#22H	;date
	ACALL I2C_SENDBYTE
	MOV A,#10H	;month
	ACALL I2C_SENDBYTE
	MOV A,#17H	;year
	ACALL I2C_SENDBYTE
	ACALL I2C_STOP
END