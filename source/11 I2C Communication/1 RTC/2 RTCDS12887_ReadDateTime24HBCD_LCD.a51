;Program: WAP to read the time (24-hour mode) and date from RTC DS12887 (BCD format) and display on LCD
E EQU P2.7
RS EQU P2.6
LCD EQU P0
ORG 00H
	ACALL LCD_INIT
	MOV R0,#10	;TURN ON OSC
	MOV A,#20H
	MOVX @R0,A
AGAIN:	MOV R4,#80H	;READ AND DISPLAY
	ACALL LCD_COMMAND
	MOV R0,#04	 ;HOURS
	MOVX A,@R0
	ACALL LCD_BCD
	MOV R4,#':'
	ACALL LCD_DATA
	MOV R0,#02	;MINUTES
	MOV A,@R0
	ACALL LCD_BCD
	MOV R4,#':'
	ACALL LCD_DATA
	MOV R0,#00	;SECONDS
	MOV A,@R0
	ACALL LCD_BCD
	MOV R4,#0C0H
	ACALL LCD_COMMAND
	MOV R0,#07	;DATE
	MOVX A,@R0
	ACALL LCD_BCD
	MOV R4,#'/'
	ACALL LCD_DATA
	MOV R0,#08	;MONTH
	MOV A,@R0
	ACALL LCD_BCD
	MOV R4,#'/'
	ACALL LCD_DATA
	MOV R4,#'2'
	ACALL LCD_DATA
	MOV R4,#'0'
	ACALL LCD_DATA
	MOV R0,#09	;YEAR
	MOV A,@R0
	ACALL LCD_BCD
	AJMP AGAIN

LCD_INIT:
	CLR E
	CLR RS
	MOV R4, #38H	;Use 2 lines and 5в7 matrix for LCD
	ACALL LCD_COMMAND
	ACALL DELAY
	MOV R4, #0CH	;LCD ON, Cursor OFF
	ACALL LCD_COMMAND
	ACALL DELAY
	MOV R4, #01H	;LCD clear
	ACALL LCD_COMMAND
RET

LCD_COMMAND:	;Function for LCD command
	CLR RS
	MOV LCD, R4
	SETB E
	ACALL DELAY
	CLR E
RET
	
LCD_DATA:	;Function for LCD data
	SETB RS
	MOV LCD, R4
	SETB E
	ACALL DELAY
	CLR E
RET

LCD_BCD:	;display BCD number on LCD
	MOV R1,A
	SWAP A
	ANL A,#0FH
	ADD A,#30H
	MOV R4, A
	ACALL LCD_DATA
	MOV A,R1
	ANL A,#0FH
	ADD A,#30H
	MOV R4, A
	ACALL LCD_DATA
RET
	
DELAY:	;Function for delay
		MOV R7, #200
LOOP1:	MOV R6, #200
LOOP:	DJNZ R6, LOOP
		DJNZ R7, LOOP1
RET
END