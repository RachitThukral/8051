;Program: WAP to turn ON 4 LEDs depending on room light intensity level using ADC0804 through channel 0 of CD74HC4052
ADC_DATA EQU P1
ADC_WR EQU P3.3
ADC_INTR EQU P3.4
MUX_SL1 EQU P3.6
MUX_SL0 EQU P3.5
LED1 EQU P1.0
LED2 EQU P1.1
LED3 EQU P1.2
LED4 EQU P1.3
ORG 00H
	MOV P1,#0FFH	;make P1 = input
	CLR MUX_SL1	;select MUX channel 0 for ADC
	CLR MUX_SL0
AGAIN:	CLR ADC_WR	;L-to-H to start conversion
	SETB ADC_WR
HERE:	JB ADC_INTR,HERE	;wait for end of conversion
	MOV R0,ADC_DATA	;read the data
	MOV A,R0	;check range
	CLR C
	SUBB A,#51
	JC L4
	MOV A,R0
	CLR C
	SUBB A,#102
	JC L3
	MOV A,R0
	CLR C
	SUBB A,#153
	JC L2
	MOV A,R0
	CLR C
	SUBB A,#204
	JC L1	
OFF:	SETB LED1	;glow LEDs acc to light level
	SETB LED2
	SETB LED3
	SETB LED4
	AJMP AGAIN
L1:	CLR LED1
	SETB LED2
	SETB LED3
	SETB LED4
	AJMP AGAIN
L2:	CLR LED1
	CLR LED2
	SETB LED3
	SETB LED4
	AJMP AGAIN
L3:	CLR LED1
	CLR LED2
	CLR LED3
	SETB LED4
	AJMP AGAIN
L4:	CLR LED1
	CLR LED2
	CLR LED3
	CLR LED4
	AJMP AGAIN
END