;Program: WAP to show the alcohol intake level of a person through 4 LEDs (use channel 1 of MAX1112)
ADC_DIN EQU P3.4
ADC_DOUT EQU P3.6
ADC_SCLK EQU P3.5
LED1 EQU P1.0
LED2 EQU P1.1
LED3 EQU P1.2
LED4 EQU P1.3
ORG 00H
AGAIN:	MOV A,#9EH	;select channel 1 of ADC
	MOV R3,#8
CTRL_WORD:	RLC A	;sending bits
	MOV ADC_DIN,C
	CLR ADC_SCLK
	ACALL DELAY
	SETB ADC_SCLK
	ACALL DELAY
	DJNZ R3,CTRL_WORD
	CLR ADC_SCLK
	SETB ADC_DOUT
	
	SETB ADC_SCLK	;receiving adc data bits
	ACALL DELAY
	CLR ADC_SCLK
	ACALL DELAY
	MOV R3,#8
ADC_DATA:	SETB ADC_SCLK
	ACALL DELAY
	CLR ADC_SCLK
	ACALL DELAY
	MOV C,ADC_DOUT
	RLC A
	DJNZ R3,ADC_DATA
	
	MOV R0,A	;check level
	CLR C
	SUBB A,#51
	JC L4
	MOV A,R0
	CLR C
	SUBB A,#102
	JC L3
	MOV A,R0
	CLR C
	SUBB A,#153
	JC L2
	MOV A,R0
	CLR C
	SUBB A,#204
	JC L1	
OFF:	SETB LED1	;show level using LEDs
	SETB LED2
	SETB LED3
	SETB LED4
	AJMP AGAIN
L1:	CLR LED1
	SETB LED2
	SETB LED3
	SETB LED4
	AJMP AGAIN
L2:	SETB LED1
	CLR LED2
	SETB LED3
	SETB LED4
	AJMP AGAIN
L3:	SETB LED1
	SETB LED2
	CLR LED3
	SETB LED4
	AJMP AGAIN
L4:	SETB LED1
	SETB LED2
	SETB LED3
	CLR LED4
	AJMP AGAIN
	ACALL DELAY
	ACALL DELAY
	ACALL DELAY
	ACALL DELAY
	ACALL DELAY
	AJMP AGAIN
	
DELAY:	;Function for delay
		MOV R7, #200
LOOP1:	MOV R6, #200
LOOP:	DJNZ R6, LOOP
		DJNZ R7, LOOP1
RET
END