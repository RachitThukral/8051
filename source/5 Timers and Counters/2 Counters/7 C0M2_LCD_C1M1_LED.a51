;Program: Count the number of times the switch is pressed at P3.4 (counter 0, mode 2) and P3.5 (counter 1, mode 1) and display on LCD and LEDs respectively
LEDS EQU P1	;P1.3-P1.0
E EQU P2.7
RS EQU P2.6
LCD EQU P0
ORG 00H
	ACALL LCD_INIT
	MOV R4, #'C'	;diplay "C1:"
	ACALL LCD_DATA
	MOV R4, #'1'
	ACALL LCD_DATA
	MOV R4, #':'
	ACALL LCD_DATA
	MOV R4, #89H
	ACALL LCD_COMMAND
	ACALL DELAY
	
	MOV TMOD,#56H	;counter0,mode2, counter1,mode1
	MOV TH0,#00H
	SETB TR0
	MOV TH1,#00H
	MOV TL1,#00H
	SETB TR1
AGAIN:
	MOV R4, #83H	;display counter 0 value on LCD
	ACALL LCD_COMMAND
	MOV A,TL0
	MOV B,#10
	DIV AB
	MOV R3,B
	MOV B,#10
	DIV AB
	ADD A,#30H
	MOV R4, A
	ACALL LCD_DATA
	MOV A,B
	ADD A,#30H
	MOV R4, A
	ACALL LCD_DATA
	MOV A,R3
	ADD A,#30H
	MOV R4, A
	ACALL LCD_DATA

	MOV A,TL1	;check counter 1 value max 16
	MOV B,#16	;display on LEDs
	DIV AB
	MOV A,B
	CJNE A,#0,CHECK_1
	MOV LEDS,#0FFH
	AJMP AGAIN
CHECK_1:	CJNE A,#1,CHECK_2
	MOV LEDS,#0FEH
	AJMP AGAIN
CHECK_2:	CJNE A,#2,CHECK_3
	MOV LEDS,#0FDH
	AJMP AGAIN
CHECK_3:	CJNE A,#3,CHECK_4
	MOV LEDS,#0FCH
	AJMP AGAIN
CHECK_4:	CJNE A,#4,CHECK_5
	MOV LEDS,#0FBH
	AJMP AGAIN
CHECK_5:	CJNE A,#5,CHECK_6
	MOV LEDS,#0FAH
	AJMP AGAIN
CHECK_6:	CJNE A,#6,CHECK_7
	MOV LEDS,#0F9H
	AJMP AGAIN
CHECK_7:	CJNE A,#7,CHECK_8
	MOV LEDS,#0F8H
	AJMP AGAIN
CHECK_8:	CJNE A,#8,CHECK_9
	MOV LEDS,#0F7H
	AJMP AGAIN
CHECK_9:	CJNE A,#9,CHECK_10
	MOV LEDS,#0F6H
	AJMP AGAIN
CHECK_10:	CJNE A,#10,CHECK_11
	MOV LEDS,#0F5H
	AJMP AGAIN
CHECK_11:	CJNE A,#11,CHECK_12
	MOV LEDS,#0F4H
	AJMP AGAIN
CHECK_12:	CJNE A,#12,CHECK_13
	MOV LEDS,#0F3H
	AJMP AGAIN
CHECK_13:	CJNE A,#13,CHECK_14
	MOV LEDS,#0F2H
	AJMP AGAIN
CHECK_14:	CJNE A,#14,CHECK_15
	MOV LEDS,#0F1H
	AJMP AGAIN
CHECK_15:	MOV LEDS,#0F0H
	AJMP AGAIN

LCD_INIT:
	CLR E
	CLR RS
	MOV R4, #38H	;Use 2 lines and 5в7 matrix for LCD
	ACALL LCD_COMMAND
	ACALL DELAY
	MOV R4, #0CH	;LCD ON, Cursor OFF
	ACALL LCD_COMMAND
	ACALL DELAY
	MOV R4, #01H	;LCD clear
	ACALL LCD_COMMAND
	ACALL DELAY
RET

LCD_COMMAND:	;Function for LCD command
	CLR RS
	MOV LCD, R4
	SETB E
	ACALL DELAY
	CLR E
RET
	
LCD_DATA:	;Function for LCD data
	SETB RS
	MOV LCD, R4
	SETB E
	ACALL DELAY
	CLR E
RET
	
DELAY:	;Function for delay
		MOV R7, #200
LOOP1:	MOV R6, #200
LOOP:	DJNZ R6, LOOP
		DJNZ R7, LOOP1
RET
END