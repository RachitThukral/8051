;Program: Timer 0 – DHT11 sensor and display humidity and temperature
E EQU P2.7
RS EQU P2.6
LCD EQU P0
DHT11 EQU P2.0
ORG 00H
	ACALL LCD_INIT
	MOV R4, #'R'	;display "RH:  %"
	ACALL LCD_DATA	;		"Temp:  C"
	MOV R4, #'H'
	ACALL LCD_DATA
	MOV R4, #':'
	ACALL LCD_DATA
	MOV R4, #86H
	ACALL LCD_COMMAND
	MOV R4, #'%'
	ACALL LCD_DATA
	MOV R4, #' '
	ACALL LCD_DATA
	MOV R4, #'T'
	ACALL LCD_DATA
	MOV R4, #'e'
	ACALL LCD_DATA
	MOV R4, #'m'
	ACALL LCD_DATA
	MOV R4, #'p'
	ACALL LCD_DATA
	MOV R4, #':'
	ACALL LCD_DATA
	MOV R4, #8FH
	ACALL LCD_COMMAND
	MOV R4, #'C'
	ACALL LCD_DATA
	
	SETB DHT11
	MOV TMOD,#01H	;timer 0, mode 1
	MOV TL1,#00D
MAIN:
	MOV R2,#5	;count for bytes
	CLR DHT11	;initial pulse for DHT11
	ACALL DELAY1
	SETB DHT11
HERE:JB DHT11,HERE	;wait for start bit
HERE1:JNB DHT11,HERE1
HERE2:JB DHT11,HERE2
NEXT_BYTE:	MOV R1,#8	;count for bits
LOOP:	JNB DHT11,LOOP	;receive bits
	RL A
	MOV R0,A
	SETB TR0
HERE41:JB DHT11,HERE41
	CLR TR0
	MOV A,TL0
	SUBB A,#50D
	MOV A,R0
	JB PSW.7, NEXT	;check if bit=0/1
	SETB ACC.0
	SJMP ESC
NEXT:CLR ACC.0
ESC: MOV TL0,#00D
	CLR PSW.7
	DJNZ R1,LOOP	;go for next bit
	MOV R5,A
	MOV A,#30H
	ADD A,R2
	MOV R0,A
	MOV A,R5
	MOV @R0,A
	DJNZ R2,NEXT_BYTE	;go for next byte
	
LCD_DHT11:	MOV R4, #83H	;display humidity
	ACALL LCD_COMMAND
	MOV R0,#35H
	MOV A,@R0
	ACALL LCD_BIN
TEMP:	MOV R4, #8DH	;display temperature
	ACALL LCD_COMMAND
	MOV R0,#33H
	MOV A,@R0
	ACALL LCD_BIN
	AJMP MAIN

LCD_INIT:
	CLR E
	CLR RS
	MOV R4, #38H	;Use 2 lines and 5×7 matrix for LCD
	ACALL LCD_COMMAND
	ACALL DELAY
	MOV R4, #0CH	;LCD ON, Cursor OFF
	ACALL LCD_COMMAND
	ACALL DELAY
	MOV R4, #01H	;LCD clear
	ACALL LCD_COMMAND
	ACALL DELAY
RET

LCD_COMMAND:			;Function for LCD command
	CLR RS
	MOV LCD, R4
	SETB E
	ACALL DELAY
	CLR E
RET
	
LCD_DATA:			;Function for LCD data
	SETB RS
	MOV LCD, R4
	SETB E
	ACALL DELAY
	CLR E
RET

LCD_BIN:
	MOV R1,A
	MOV B,#10
	DIV AB
	MOV R3,B
	MOV B,#10
	DIV AB
	MOV A,B
	ADD A,#30H
	MOV R4, A
	ACALL LCD_DATA
	MOV A,R3
	ADD A,#30H
	MOV R4, A
	ACALL LCD_DATA
RET

DELAY1:	;for DHT11
	MOV TH0,#0B9H
	MOV TL0,#0B0H
	SETB TR0
HERE51:	JNB TF0,HERE51
	CLR TR0
	CLR TF0
RET
	   
DELAY:	;Function for delay
		MOV R7, #200
LOOP1:	MOV R6, #200
LOOP2:	DJNZ R6, LOOP2
		DJNZ R7, LOOP1
RET	
END