;Program: Timer 0, Mode 1 – LED 1 blink 1s, Timer 1, Mode 0 – LCD counting
LED1 EQU P1.0
LED2 EQU P1.1
COUNT_TIMER0 EQU R0
COUNT_TIMER1 EQU R1
LCDCOUNT EQU R2
E EQU P2.7
RS EQU P2.6
LCD  EQU P0
ORG 00H
	ACALL LCD_INIT
	MOV LCDCOUNT,#0
	MOV TMOD,#01H	;Timer 0,1 - mode 1,0(16,13-bit mode)
	MOV COUNT_TIMER0,#14
	MOV COUNT_TIMER1,#112
	MOV TL0,#0C0H
	MOV TH0,#00H
	MOV TL1,#18H
	MOV TH1,#02H
	SETB TR0	;start the timer 0
	SETB TR1	;start the timer 1
MAIN:
	JB TF0,TIMER0_COUNT
	JB TF1,TIMER1_COUNT
	SJMP MAIN
	
TIMER0_COUNT:	CLR TR0	;stop timer 0
	CLR TF0	;clear timer 0 flag
	DJNZ COUNT_TIMER0,TIMER0
		MOV COUNT_TIMER0,#14
		CPL LED1
TIMER0:	MOV TL0,#18H
	MOV TH0,#02H
	SETB TR0	;start the timer 0
	AJMP MAIN
	
TIMER1_COUNT:	CLR TR1	;stop timer 1
	CLR TF1	;clear timer 1 flag
	DJNZ COUNT_TIMER1,TIMER1
	MOV COUNT_TIMER1,#112
	MOV R4, #80H
	ACALL LCD_COMMAND
	MOV A,R2
	MOV B,#10
	DIV AB
	MOV R3,B
	MOV B,#10
	DIV AB
	ADD A,#30H
	MOV R4, A
	ACALL LCD_DATA
	MOV A,B
	ADD A,#30H
	MOV R4, A
	ACALL LCD_DATA
	MOV A,R3
	ADD A,#30H
	MOV R4, A
	ACALL LCD_DATA
	INC R2
TIMER1:	MOV TL1,#0C0H
	MOV TH1,#00H
	SETB TR1	;start the timer 1
	AJMP MAIN
	
LCD_INIT:
	CLR E
	CLR RS
	MOV R4, #38H	;Use 2 lines and 5×7 matrix for LCD
	ACALL LCD_COMMAND
	ACALL DELAY
	MOV R4, #0CH	;LCD ON, Cursor OFF
	ACALL LCD_COMMAND
	ACALL DELAY
	MOV R4, #01H	;LCD clear
	ACALL LCD_COMMAND
	ACALL DELAY
RET
	
LCD_COMMAND:	;Function for LCD command
	CLR RS
	MOV LCD, R4
	SETB E
	ACALL DELAY
	CLR E
RET
	
LCD_DATA:	;Function for LCD data
	SETB RS
	MOV LCD, R4
	SETB E
	ACALL DELAY
	CLR E
RET
	
DELAY:	;Function for delay
		MOV R7, #200
LOOP1:	MOV R6, #200
LOOP:	DJNZ R6, LOOP
		DJNZ R7, LOOP1
RET
END