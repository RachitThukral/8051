;Program: Rx 0 to 9 using UART and display on 7-segment
SEVSEG EQU P1
ORG 00H
	MOV TMOD,#20H	;timer 1 mode 2
	MOV TH1,#0FDH	;9600 baud
	MOV SCON,#50H	;enable UART
	SETB TR1	;enable timer 1
MAIN:
	JNB RI,MAIN	;wait for reception
	CLR RI	;and clear RI
	MOV A,SBUF	;received character
	CJNE A,#'0',CHECK_1	;check for numbers and
	MOV SEVSEG,#0E0H	;display on 7-segment
	AJMP MAIN
CHECK_1:	CJNE A,#1,CHECK_2
	MOV SEVSEG,#21H
	AJMP MAIN
CHECK_2:	CJNE A,#2,CHECK_3
	MOV SEVSEG,#0CBH
	AJMP MAIN
CHECK_3:	CJNE A,#3,CHECK_4
	MOV SEVSEG,#0ABH
	AJMP MAIN
CHECK_4:	CJNE A,#4,CHECK_5
	MOV SEVSEG,#2DH
	AJMP MAIN
CHECK_5:	CJNE A,#5,CHECK_6
	MOV SEVSEG,#0AEH
	AJMP MAIN
CHECK_6:	CJNE A,#6,CHECK_7
	MOV SEVSEG,#0EEH
	AJMP MAIN
CHECK_7:	CJNE A,#7,CHECK_8
	MOV SEVSEG,#23H
	AJMP MAIN
CHECK_8:	CJNE A,#8,CHECK_9
	MOV SEVSEG,#0EFH
	AJMP MAIN
CHECK_9:	CJNE A,#9,MAIN
	MOV SEVSEG,#0AFH
	AJMP MAIN
END