;Program: Read an SMS from GSM
E EQU P2.7
RS EQU P2.6
LCD EQU P0
ORG 00H
	MOV TMOD,#20H	;timer 1 mode 2
	MOV TH1,#0FDH	;9600 baud
	MOV SCON,#50H	;enable UART
	SETB TR1	;enable timer 1
	ACALL LCD_INIT
MAIN:
	MOV DPTR,#TEXT_MODE	;text mode (AT+CMGF=1)
NEXT:	CLR A
	MOVC A,@A+DPTR
	CJNE A,#0x0D,SEND_MODE
	MOV A,#0x0D
	ACALL Tx_data
	SJMP FRST_SMS
SEND_MODE:	ACALL Tx_data
	INC DPTR
	SJMP NEXT

FRST_SMS:	MOV DPTR,#FIRST_SMS	;first SMS (AT+CMGR=1)
NEXT1:	CLR A
	MOVC A,@A+DPTR
	CJNE A,#0x0D,SMS_1
	MOV A,#0x0D
	ACALL Tx_data
	SJMP HERE
SMS_1:	ACALL Tx_data
	INC DPTR
	SJMP NEXT1
HERE:	ACALL Rx_data	;receive SMS
	CJNE A,#'+',HERE
HERE1:	ACALL Rx_data
	CJNE A,#0DH,HERE1
	ACALL Rx_data
	CJNE A,#0DH,HERE1
	MOV R0,#30H
	MOV R1,#5
REC_MSG:	ACALL Rx_data	;receive SMS text
	MOV @R0,A
	INC R0
	DJNZ R1,REC_MSG
	MOV R0,#30H
	MOV R1,#5
	MOV R4, #01H	;display SMS on LCD
	ACALL LCD_COMMAND
LCD_MSG:
	MOV A,@R0
	MOV R4,A
	ACALL LCD_DATA
	DJNZ R1,LCD_MSG
	AJMP MAIN

Tx_data:	;UART send
	CLR TI
    MOV SBUF,A
WAIT:	JNB TI,WAIT
RET

Rx_data:	;UART receive
	JNB RI,Rx_data
	CLR RI
    MOV A,SBUF
RET

LCD_INIT:
	CLR E
	CLR RS
	MOV R4, #38H	;Use 2 lines and 5в7 matrix for LCD
	ACALL LCD_COMMAND
	ACALL DELAY
	MOV R4, #0CH	;LCD ON, Cursor OFF
	ACALL LCD_COMMAND
	ACALL DELAY
	MOV R4, #01H	;LCD clear
	ACALL LCD_COMMAND
	ACALL DELAY
RET

LCD_COMMAND:	;Function for LCD command
	CLR RS
	MOV LCD, R4
	SETB E
	ACALL DELAY
	CLR E
	RET
	
LCD_DATA:	;Function for LCD data
	SETB RS
	MOV LCD, R4
	SETB E
	ACALL DELAY
	CLR E
RET
	
DELAY:	;Function for delay
		MOV R7, #200
LOOP1:	MOV R6, #200
LOOP:	DJNZ R6, LOOP
		DJNZ R7, LOOP1
RET

TEXT_MODE: DB "AT+CMGF=1",0x0D
FIRST_SMS: DB "AT+CMGR=1",0x0D
END